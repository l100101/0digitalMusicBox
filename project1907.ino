// https://www.youtube.com/watch?v=P73WA0VEFjo&ab_channel=SheetMusicBoss
// Зажимаем (кнопку?), заполняется светодиодная шкала, включается музыка,
// светодиоды мигают
// 2 аудиофайла, 2 проигрывателя, нижние частоты, верхние
// 258 not
//6pin +
//7,9 pin -

// int notes[300] = {698, 523, 415, 349, 494, 466, 466, 415, 330, 349, 523, 466, 415,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 698, 831};
int notes[305] = { 698, 523, 415, 349, 494, 466, 466, 415, 330, 349, 523, 466, 415,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 1245, 1047 };

// int delays[300] = {247, 247, 247, 247, 123, 247, 123, 123, 123, 123, 123, 123, 123,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 123, 123};
int delays[305] = { 247, 247, 247, 247, 123, 247, 123, 123, 123, 123, 123, 123, 123,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 123, 123 };

#define STRIP_PIN 2   // пин ленты
#define BUTTON_PIN 4  // пин sensor button
#define BUTTON_PLUS 6 //sensor button +
#define BUTTON_MINUS 7 //sensor button -
#define BUZZER_MINUS 9 //buzzer -
 

const int SPEAKER = 11;

#define NUMLEDS 26  // кол-во светодиодов
#define COLOR_DEBTH 3

#include <microLED.h>  // подключаем библу
microLED<NUMLEDS, STRIP_PIN, MLED_NO_CLOCK, LED_WS2818, ORDER_GRB, CLI_AVER> strip;

#include <TimerMs.h>
// (период, мс), (0 не запущен / 1 запущен), (режим: 0 период / 1 таймер)
TimerMs tmr(2000, 1, 1);
TimerMs tmrRst(10*1000, 0, 1);
TimerMs stripTmr(10, 1, 0);

#include <EncButton.h>
EncButton<EB_TICK, VIRT_BTN> enc;  // виртуальная кнопка

boolean rdy = 0;
byte state = 0;
byte hold_cntr = 0;
byte counter = 0;  // для радуги

void setup() {
  Serial.begin(9600);
  pinMode(BUTTON_PIN, INPUT);  // подтянем пин
  pinMode(BUTTON_PLUS, OUTPUT);
  pinMode(BUTTON_MINUS, OUTPUT);
  pinMode(BUZZER_MINUS, OUTPUT);
  digitalWrite(BUTTON_PLUS, 1);
  digitalWrite(BUTTON_MINUS, 0);
  digitalWrite(BUZZER_MINUS, 0);



  enc.setHoldTimeout(150);  // установка таймаута удержания кнопки
  enc.setStepTimeout(100);
  strip.setBrightness(60);
}

void loop() {
  enc.tick(digitalRead(BUTTON_PIN));

  switch (state) {
    case 0:
      if (enc.step()) {
        // Serial.println("step");
        hold_cntr++;
        strip.fill(0, hold_cntr, mPurple);
      }
      if (hold_cntr > NUMLEDS) {
        hold_cntr = 0;
        state = 1;
      }
      break;

    case 1:
      runningDots();
      song2(SPEAKER);
      break;
    case 2:
      strip.fill(0, NUMLEDS, mPurple);
if(!tmrRst.


      break;
    default:
      break;
  }

  if (stripTmr.tick()) {
    breathing();
    strip.show();  // вывод
  }
  // Serial.print(rdy);
  // Serial.print("- rdy | hold_counter:");
  // Serial.println(hold_cntr);
}

void breathing() {
  static int dir = 1;
  static int bright = 0;
  bright += dir * 5;  // 5 - множитель скорости изменения

  if (bright > 255) {
    bright = 255;
    dir = -1;
  }
  if (bright < 20) {
    bright = 20;
    dir = 1;
  }
  strip.setBrightness(bright);
}
void runningDots() {
  static byte counter = 0;
  // перемотка буфера со сдвигом (иллюзия движения пикселей)
  for (int i = 0; i < NUMLEDS - 1; i++)
    strip.leds[i] = strip.leds[i + 1];

  // каждый третий вызов - последний пиксель красным, иначе чёрным
  if (counter % 3 == 0)
    strip.leds[NUMLEDS - 1] = mPurple;
  else
    strip.leds[NUMLEDS - 1] = mBlack;
  counter++;
  delay(100);  // дополнительная задержка
}
void song2(int buzzerPin) {
  static unsigned int i = 0;  // для музыки
  if (tmr.tick()) {

    tone(buzzerPin, notes[i], delays[i] - 10);
    tmr.setTime(delays[i]);
    tmr.start();
    i++;
  }
  if (i > 258) {
    noTone(SPEAKER);
    strip.fill(0, NUMLEDS, mBlack);
    i = 0;
    rdy = 0;
    state = 2;
  }
}
